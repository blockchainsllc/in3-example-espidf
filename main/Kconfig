## main/Kconfig
```kconfig
menu "IN3"
    config WIFI_SSID
        string "WiFi SSID"
        default "myssid"
        help
            SSID (network name) for the example to connect to.

    config WIFI_PASSWORD
        string "WiFi Password"
        default "mypassword"
        help
            WiFi password (WPA or WPA2) for the example to use.
            Can be left blank if the network has no security set.

    config CONTRACT_ADDRESS
        string "Address to deployed contract"
        default "0x36643F8D17FE745a69A2Fd22188921Fade60a98B"
        help
            Deploy the contract with your favorite tool (ie truffle, etc) 
            or use our previously deployed contract on goerli using the default address.
endmenu
```

## sdkconfig.defaults
```kconfig
CONFIG_WIFI_SSID="YOUR-SSID"
CONFIG_WIFI_PASSWORD="YOUR PWD"
CONFIG_PARTITION_TABLE_CUSTOM=y
CONFIG_PARTITION_TABLE_CUSTOM_FILENAME="partitions.csv"
CONFIG_PARTITION_TABLE_FILENAME="partitions.csv"
CONFIG_HEAP_ABORT_WHEN_ALLOCATION_FAILS=y
CONFIG_ESP_MAIN_TASK_STACK_SIZE=72584
```
